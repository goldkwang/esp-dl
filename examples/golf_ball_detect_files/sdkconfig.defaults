## examples/golf_ball_detect_files/sdkconfig.defaults
```kconfig
# Enable PSRAM for ESP32-S3
CONFIG_ESP32S3_SPIRAM_SUPPORT=y
CONFIG_SPIRAM_MODE_OCT=y
CONFIG_SPIRAM_SPEED_80M=y

# Use SPIRAM for malloc
CONFIG_SPIRAM_USE_MALLOC=y
CONFIG_SPIRAM_MALLOC_ALWAYSINTERNAL=16384
CONFIG_SPIRAM_MALLOC_RESERVE_INTERNAL=32768

# Enable more heap memory debugging
CONFIG_HEAP_POISONING_LIGHT=y

# Cat detection model config
CONFIG_CAT_DETECT_MODEL_LOCATION=0
CONFIG_FLASH_ESPDET_PICO_224_224_CAT=y

# Golf ball detection model config
CONFIG_GOLF_BALL_DETECT_MODEL_LOCATION=0
CONFIG_FLASH_GOLF_BALL_99_4_MAP=y
```

## models/golf_ball_detect/Kconfig.projbuild
```kconfig
menu "Golf Ball Detect"
    choice GOLF_BALL_DETECT_MODELS
        prompt "Select golf ball detect models"
        default FLASH_GOLF_BALL_99_4_MAP

        config FLASH_GOLF_BALL_99_4_MAP
            bool "golf_ball_99_4_mAP"
    endchoice

    choice GOLF_BALL_DETECT_MODEL_LOCATION
        prompt "Select model storage location"
        default GOLF_BALL_DETECT_MODEL_IN_FLASH_RODATA

        config GOLF_BALL_DETECT_MODEL_IN_FLASH_RODATA
            bool "Store the model in Flash RODATA"
        config GOLF_BALL_DETECT_MODEL_IN_FLASH_PARTITION
            bool "Store the model in a flash partition"
        config GOLF_BALL_DETECT_MODEL_IN_SDCARD
            bool "Store the model in a SDcard"
    endchoice

    config GOLF_BALL_DETECT_MODEL_SDCARD_DIR
        string "Model file directory in SDCard"
        depends on GOLF_BALL_DETECT_MODEL_IN_SDCARD
        default "models"
        help
            Name of directory where model files will be kept.
endmenu
```
